## Kconfig
```kconfig
# Kconfig - main configuration options for Minos
#
# Copyright (c) 2019 Min Le <lemin9538@gmail.com>
#
#
mainmenu "Minos $ARCH Configuration"

config SRCARCH
	string
	option env="SRCARCH"

source "arch/$(SRCARCH)/Kconfig"
```

## apps/Kconfig
```kconfig
menu "Application Config"

config SHELL
	bool "Shell support"
	default n
	help
	  "hell support using ESH from Chris Pavlina"

source "apps/esh/Kconfig"

endmenu
```

## apps/esh/Kconfig
```kconfig
if SHELL

menu "Shell config"

config SHELL_TASK_PRIO
	int "The priority of shell task"
	default 63

endmenu

endif
```

## arch/aarch64/Kconfig
```kconfig
config ARCH_AARCH64
	def_bool y
	select DEVICE_TREE
	select 64BIT
	help
	  AARCH64 Minos support

config 64BIT
	def_bool y

source "arch/aarch64/core/Kconfig"

if VIRT
source "arch/aarch64/virt/Kconfig"
endif

source "core/Kconfig"
source "virt/Kconfig"
source "drivers/Kconfig"
source "platform/Kconfig"
source "external/Kconfig"
source "apps/Kconfig"
source "libsys/Kconfig"
```

## arch/aarch64/core/Kconfig
```kconfig
menu "Minos aarch64 Arch Feature"

config NR_CPUS_CLUSTER0
	int "cpu number in cluster0"
	default 4
	help
	  cpu count in SOC cluster0, this
	  will help to caculate the cpuid

config NR_CPUS_CLUSTER1
	int "cpu number in cluster1"
	default 0
	help
	  cpu count in SOC cluster1, this
	  will help to caculate the cpuid

config EXCEPTION_STACK_SIZE
	hex "the stack size of the exception vector"
	default 0x2000
	help
	  the stack size of the exception vector

config ARM_ATOMIC_LSE
	bool "use lse atomic instruction"
	default n
	help
	  this require at leaset armv8.1 soc

config ARM_ADDRESS_TAGGING
	bool
	default (VIRT && ARM_VHE) || (!VIRT)

config PTOV_MASK
	hex
	default 0xffffff8000000000 if ARM_ADDRESS_TAGGING
	default 0x0

config VTOP_MASK
	hex
	default 0x0000007fffffffff if ARM_ADDRESS_TAGGING
	default 0x0

endmenu
```

## arch/aarch64/virt/Kconfig
```kconfig
menu "Minos aarch64 virtualaztion features"

config ARM_VHE
	bool "enable VHE feature for minos"
	depends on VIRT
	default n
	help
	  this require at leaset armv8.1 soc

endmenu
```

## configs/r8a7795_defconfig
```kconfig
CONFIG_NR_CPUS_CLUSTER1=4
CONFIG_SMP=y
CONFIG_NR_SPI_IRQS=480
CONFIG_LOG_LEVEL_COLORFUL=y
CONFIG_VIRT=y
CONFIG_SOC_R8A7795=y
CONFIG_SHELL=y
```

## configs/rpi_3_defconfig
```kconfig
CONFIG_ARCH_AARCH64=y
CONFIG_PLATFORM_RASPBERRY3=y
CONFIG_DEVICE_TREE=y
CONFIG_SERIAL_BCM283X_MU=y
CONFIG_IRQCHIP_BCM2836=y
CONFIG_VIRQCHIP_VGICV2=y
CONFIG_VIRQCHIP_VGICV3=y
CONFIG_VIRQCHIP_BCM2836=y
CONFIG_VIRTIO_MMIO=y
CONFIG_VRTC_PL031=y
CONFIG_VWDT_SP805=y

CONFIG_MINOS_START_ADDRESS=0x28000000
CONFIG_MINOS_ENTRY_ADDRESS=0x28008000
CONFIG_MINOS_RAM_SIZE=308M
CONFIG_MAX_CPU_NR=8
CONFIG_NR_CPUS=4
CONFIG_NR_CPUS_CLUSTER0=4
CONFIG_NR_CPUS_CLUSTER1=0

CONFIG_UART_BASE=0x3f215040
CONFIG_UART_IO_SIZE=0x1000
CONFIG_PLATFORM_ADDRESS_RANGE=40

CONFIG_HVM_SPI_VIRQ_NR=96

CONFIG_TASK_RUN_TIME=100

CONFIG_VIRT=y

CONFIG_EXCEPTION_SIZE=8192

CONFIG_TASK_STACK_SIZE=8192
CONFIG_TASK_STACK_SHIFT=13
CONFIG_STACK_PAGE_ALIGN=y
CONFIG_SMP=y
```

## configs/rpi_4_defconfig
```kconfig
CONFIG_ARCH_AARCH64=y
CONFIG_64BIT=y

#
# Minos aarch64 Arch Feature
#
CONFIG_NR_CPUS_CLUSTER0=4
CONFIG_NR_CPUS_CLUSTER1=0
# CONFIG_MPIDR_SHIFT is not set
CONFIG_PLATFORM_ADDRESS_RANGE=40
CONFIG_EXCEPTION_STACK_SIZE=0x2000
# end of Minos aarch64 Arch Feature

#
# Minos aarch64 virtualaztion features
#

#
# Minos OS configuration
#
CONFIG_MAX_CPU_NR=8
# CONFIG_TASK_STACK_SIZE_4K is not set
CONFIG_TASK_STACK_SIZE_8K=y
CONFIG_TASK_STACK_SIZE=0x2000
CONFIG_TASK_STACK_SHIFT=13
CONFIG_STACK_PAGE_ALIGN=y
CONFIG_MAX_SLAB_BLOCKS=10
CONFIG_TASK_RUN_TIME=100
CONFIG_MINOS_IRQWORK_IRQ=5
CONFIG_SMP_FUNCTION_CALL_IRQ=6
CONFIG_MINOS_RESCHED_IRQ=7
CONFIG_SMP=y
CONFIG_NR_SGI_IRQS=16
CONFIG_NR_PPI_IRQS=16
CONFIG_NR_SPI_IRQS=256
# CONFIG_OS_REALTIME_CORE0 is not set
# CONFIG_PRINT_DEBUG is not set
# CONFIG_PRINT_INFO is not set
CONFIG_PRINT_NOTICE=y
# CONFIG_PRINT_WARN is not set
# CONFIG_PRINT_ERROR is not set
CONFIG_LOG_LEVEL=3
# end of Minos OS configuration

#
# Minos Virtualization Configuration
#
CONFIG_VIRT=y
CONFIG_VIRTIO_MMIO=y
CONFIG_MAX_VM=64
CONFIG_VRTC_PL031=y
CONFIG_VWDT_SP805=y

#
# Virqchip controller support
#
CONFIG_VIRQCHIP_VGICV2=y
CONFIG_VIRQCHIP_VGICV3=y
# CONFIG_VIRQCHIP_BCM2836 is not set
CONFIG_VIRQCHIP_AIC=y
# end of Virqchip controller support

CONFIG_VMBOX=y

#
# VM operating system support
#
CONFIG_OS_LINUX_SUPPORT=y
CONFIG_OS_XNU_SUPPORT=y
# end of VM operating system support
# end of Minos Virtualization Configuration

#
# Device Drivers
#

#
# Interrupt Controller Driver
#
# CONFIG_IRQCHIP_GICV3 is not set
CONFIG_IRQCHIP_GICV2=y
# CONFIG_IRQCHIP_BCM2836 is not set
# end of Interrupt Controller Driver

#
# Serial Drivers
#
CONFIG_SERIAL=y
CONFIG_SERIAL_BCM283X_MU=y
# CONFIG_SERIAL_MVEBU_A3700 is not set
# CONFIG_SERIAL_PL011 is not set
# CONFIG_SERIAL_AMLOGIC is not set
# end of Serial Drivers

CONFIG_DEVICE_TREE=y
# end of Device Drivers

#
# Platform Configuration
#
# CONFIG_SOC_FVP is not set
# CONFIG_SOC_MARVELL_A3700 is not set
# CONFIG_SOC_BCM2837 is not set
CONFIG_SOC_BCM2838=y
# CONFIG_SOC_AMLOGIC is not set
CONFIG_MINOS_ENTRY_ADDRESS=0x37408000
CONFIG_MINOS_RAM_SIZE=0x4000000
CONFIG_NR_CPUS=4
CONFIG_UART_BASE=0xfe215040
CONFIG_UART_IO_SIZE=0x1000
# end of Platform Configuration

#
# Third Party Library And Module
#

#
# Application Config
#
CONFIG_SHELL=y

#
# Shell config
#
CONFIG_SHELL_TASK_PRIO=63
# end of Shell config
# end of Application Config

#
# System libary config
#

#
# Shell Command Support
#
CONFIG_SHELL_COMMAND_TASK=y
# end of Shell Command Support
# end of System libary config
```

## core/Kconfig
```kconfig
menu "Minos OS configuration"

config MAX_CPU_NR
	int "max cpu in system"
	default 8
	help
	  max cpu count in system

choice
	prompt "default task stack size"
	default TASK_STACK_SIZE_8K
	config TASK_STACK_SIZE_4K
		bool "4K"
	config TASK_STACK_SIZE_8K
		bool "8k"
endchoice

config TASK_STACK_SIZE
	hex
	default 0x1000 if TASK_STACK_SIZE_4K
	default 0x2000 if TASK_STACK_SIZE_8K
	default 0x2000

config TASK_STACK_SHIFT
	int
	default 12 if TASK_STACK_SIZE_4K
	default 13
	range 12 14
	help
	  the shift size of task stack

config STACK_PAGE_ALIGN
	bool "stack size is 4K align"
	default n
	help
	  "the stack for all the task need 4K align"

config MAX_SLAB_BLOCKS
	int "default SLAB blocks"
	default 10

config TASK_RUN_TIME
	int "default task run time in ms"
	default 100

config MINOS_RESCHED_IRQ
	int "default resched IRQ number"
	default 7

config SMP
	bool "SMP system"
	help
	  smp system

config OS_REALTIME_CORE0
	bool "all realtime task will affinity to core 0"
	default n
	help
	  if enable this feature, all the realtime task will
	  affinity to cpu0

choice
	prompt "Printf log level"
	default PRINT_NOTICE
	config PRINT_DEBUG
		bool "Log Level DEBUG"
	config PRINT_INFO
		bool "Log Level INFO"
	config PRINT_NOTICE
		bool "Log Level NOTICE"
	config PRINT_WARN
		bool "Log Level WARNING"
	config PRINT_ERROR
		bool "Log Level ERROR"
endchoice

config LOG_LEVEL
	int
	default 5 if PRINT_DEBUG
	default 4 if PRINT_INFO
	default 3 if PRINT_NOTICE
	default 2 if PRINT_WARN
	default 1 if PRINT_ERROR
	default 3

endmenu
```

## drivers/Kconfig
```kconfig
menu "Device Drivers"

source "drivers/irq-chips/Kconfig"
source "drivers/serial/Kconfig"

config DEVICE_TREE
	bool "device tree libfdt support"
	default y

endmenu
```

## drivers/iommu/Kconfig
```kconfig
# SPDX-License-Identifier: GPL-2.0

if VIRT

menu "IOMMU drivers"

config IOMMU
	def_bool y

config IOMMU_IPMMU
	bool "ipmmu driver"
	default y if SOC_R8A7795
	help
	  iommu driver for r8a7795

endmenu

endif

comment "IOMMU drivers need virtualization support"
	depends on !VIRT
```

## drivers/irq-chips/Kconfig
```kconfig
menu "Interrupt Controller Driver"

config IRQCHIP_GICV3
	bool "gicv3 driver"
	default n
	help
	  "GICv3 interrupt controller driver"

config IRQCHIP_GICV2
	bool "gicv2 driver"
	default n
	help
	  "GICv2 interrupt controller driver"

config IRQCHIP_BCM2836
	bool "bcm2836/2835 interrupt controller driver"
	default n
	help
	  "interrupt controller driver for raspberry PI 3"

endmenu
```

## drivers/serial/Kconfig
```kconfig
menu "Serial Drivers"

config SERIAL
	def_bool y

if SERIAL
config SERIAL_BCM283X_MU
	bool "support bcm283x mu serial"
	default n
	help
	  serial driver for rpi-3b

config SERIAL_MVEBU_A3700
	bool "support marvell a3700 serial driver"
	default n
	help
	  serial driver for a3700 soc

config SERIAL_PL011
	bool "pl011 serial driver"
	default n
	help
	  serial driver for pl011
endif

endmenu
```

## generic/minos-linux-driver/Kconfig
```kconfig
menu "Minos"

config MINOS
	bool "Enable Minos Hypervisor driver"
	default y
	select HVC_DRIVER
	select HVC_IRQ
	---help---
	  Enable support for Minos hyperviosr

if MINOS

config VIRTIO_CONSOLE_EARLY_PRINTK
	bool "early printk based on virtio console device"
	default y

endif

endmenu
```

## hypervisor/configs/espressobin_defconfig
```kconfig
CONFIG_ARCH_AARCH64=y
CONFIG_PLATFORM_ARMADA=y
CONFIG_DEVICE_TREE=y
CONFIG_SERIAL_MVEBU_A3700=y
CONFIG_IRQCHIP_GICV3=y
CONFIG_IRQCHIP_GICV2=y
CONFIG_VIRQCHIP_VGICV2=y
CONFIG_VIRQCHIP_VGICV3=y
CONFIG_VIRTIO_MMIO=y
CONFIG_VRTC_PL031=y
CONFIG_VWDT_SP805=y

CONFIG_RAM_START_ADDRESS=0x00000000
CONFIG_RAM_SIZE=0x40000000

CONFIG_MINOS_START_ADDRESS=0x3c000000
CONFIG_MINOS_RAM_SIZE=64M
CONFIG_MAX_CPU_NR=8
CONFIG_NR_CPUS=2
CONFIG_NR_CPUS_CLUSTER0=2
CONFIG_NR_CPUS_CLUSTER1=0

CONFIG_UART_BASE=0xd0012000
CONFIG_UART_IO_SIZE=0x4000
CONFIG_PLATFORM_ADDRESS_RANGE=40
```

## libs/shell_command/Kconfig
```kconfig
if SHELL

menu "Shell Command Support"

config SHELL_COMMAND_TASK
	bool "Command for task management"
	default y
	help
	  "command for task management"

endmenu

endif
```

## os/configs/espressobin_defconfig
```kconfig
CONFIG_ARCH_AARCH64=y
CONFIG_PLATFORM_ARMADA=y
CONFIG_DEVICE_TREE=y
CONFIG_SERIAL_MVEBU_A3700=y
CONFIG_IRQCHIP_GICV3=y
CONFIG_IRQCHIP_GICV2=y
CONFIG_VIRQCHIP_VGICV2=y
CONFIG_VIRQCHIP_VGICV3=y
CONFIG_VIRTIO_MMIO=y
CONFIG_VRTC_PL031=y
CONFIG_VWDT_SP805=y

CONFIG_MINOS_START_ADDRESS=0x3c000000
CONFIG_MINOS_ENTRY_ADDRESS=0x3c004000
CONFIG_MINOS_RAM_SIZE=64M

CONFIG_MAX_CPU_NR=8
CONFIG_NR_CPUS=2
CONFIG_NR_CPUS_CLUSTER0=2
CONFIG_NR_CPUS_CLUSTER1=0

CONFIG_UART_BASE=0xd0012000
CONFIG_UART_IO_SIZE=0x4000
CONFIG_PLATFORM_ADDRESS_RANGE=40

# all realtime task will sched at core0
# CONFIG_OS_REALTIME_CORE0

CONFIG_TASK_RUN_TIME=100

CONFIG_VIRT=y

CONFIG_EXCEPTION_SIZE=8192

CONFIG_TASK_STACK_SIZE=8192
CONFIG_TASK_STACK_SHIFT=13
CONFIG_STACK_PAGE_ALIGN=y
CONFIG_SMP=y
```

## os/configs/fvp_defconfig
```kconfig
CONFIG_ARCH_AARCH64=y
CONFIG_DEVICE_TREE=y
CONFIG_PLATFORM_FVP=y
CONFIG_SERIAL_PL011=y
CONFIG_IRQCHIP_GICV3=y
CONFIG_IRQCHIP_GICV2=y
CONFIG_VIRQCHIP_VGICV2=y
CONFIG_VIRQCHIP_VGICV3=y
CONFIG_VIRTIO_MMIO=y
CONFIG_VRTC_PL031=y
CONFIG_VWDT_SP805=y

CONFIG_RAM_START_ADDRESS=0x80000000
CONFIG_RAM_SIZE=0x80000000

CONFIG_MINOS_START_ADDRESS=0xc0000000
CONFIG_MINOS_RAM_SIZE=64M
CONFIG_MAX_CPU_NR=8
CONFIG_NR_CPUS=4
CONFIG_NR_CPUS_CLUSTER0=4
CONFIG_NR_CPUS_CLUSTER1=0

CONFIG_UART_BASE=0x1c090000
CONFIG_UART_IO_SIZE=0x40000
CONFIG_PLATFORM_ADDRESS_RANGE=40

CONFIG_TASK_DEFAULT_STACK_SIZE=4K
CONFIG_IDLE_TASK_STACK_SHIFT=12

CONFIG_STACK_PAGE_ALIGN=y

# CONFIG_OS_REALTIME_CORE0	all realtime task will sched at core0
```

## os/configs/rpi_4_defconfig
```kconfig
CONFIG_ARCH_AARCH64=y
CONFIG_PLATFORM_RASPBERRY4=y
CONFIG_DEVICE_TREE=y
CONFIG_IRQCHIP_GICV2=y
CONFIG_VIRQCHIP_VGICV2=y
CONFIG_VIRQCHIP_VGICV3=y
CONFIG_VIRTIO_MMIO=y
CONFIG_VRTC_PL031=y
CONFIG_VWDT_SP805=y

# the memory base of hypervisor
CONFIG_RAM_START_ADDRESS=0x00000000
CONFIG_RAM_SIZE=0xf3000000

CONFIG_MINOS_START_ADDRESS=0x40000000
CONFIG_MINOS_ENTRY_ADDRESS=0x40008000
CONFIG_MINOS_RAM_SIZE=2864M
CONFIG_MAX_CPU_NR=8
CONFIG_NR_CPUS=4
CONFIG_NR_CPUS_CLUSTER0=4
CONFIG_NR_CPUS_CLUSTER1=0

CONFIG_UART_BASE=0xfe215040
CONFIG_UART_IO_SIZE=0x1000
CONFIG_PLATFORM_ADDRESS_RANGE=40

CONFIG_HVM_SPI_VIRQ_NR=96

CONFIG_TASK_RUN_TIME=100

CONFIG_VIRT=y

CONFIG_EXCEPTION_SIZE=8192

CONFIG_TASK_STACK_SIZE=8192
CONFIG_TASK_STACK_SHIFT=13
CONFIG_STACK_PAGE_ALIGN=y
CONFIG_SMP=y
```

## platform/Kconfig
```kconfig
menu "Platform Configuration"

choice
	prompt "SOC current used"
	config SOC_FVP
		bool "arm fix virtual platform"
	config SOC_MARVELL_A3700
		bool "marvell a3700 SOC"
	config SOC_BCM2837
		bool "bcm2837 SOC"
	config SOC_BCM2838
		bool "bcm2838 SOC"
	config SOC_AMLOGIC
		bool "amlogic SOC"
	config SOC_R8A7795
		bool "r8a7795 SOC"
		select IRQCHIP_GICV2
		select SERIAL_SCIF
endchoice

source "platform/espressobin/Kconfig"
source "platform/fvp/Kconfig"
source "platform/raspberry3/Kconfig"
source "platform/raspberry4/Kconfig"
source "platform/amlogic/Kconfig"
source "platform/r8a7795/Kconfig"

endmenu
```

## platform/amlogic/Kconfig
```kconfig
if SOC_AMLOGIC

config MINOS_ENTRY_ADDRESS
	hex "entry address of system"
	default 0xeb80c000
	help
	  the entry address is the start address plus
	  nr_cpus * TASK_STACK_SIZE, the kvim3 has 6 cores

config MINOS_RAM_SIZE
	hex "memory size for Minos"
	default 0x2000000
	range 0x1000000 0x4000000
	help
	  the memory size for Minos

config NR_CPUS
	int "number of cpu in system"
	default 6
	help
	  how many cpu in current system

config UART_BASE
	hex "uart controller memory base"
	default 0xff803000

config UART_IO_SIZE
	hex "uart controller iomem size"
	default 0x1000

config DTB_LOAD_ADDRESS
	hex
	default 0xed600000

endif
```
