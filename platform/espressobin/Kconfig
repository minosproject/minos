## platform/espressobin/Kconfig
```kconfig
if SOC_MARVELL_A3700

config MINOS_ENTRY_ADDRESS
	hex "entry address of system"
	default 0x3c004000
	help
	  the entry address is the start address plus
	  nr_cpus * TASK_STACK_SIZE

config MINOS_RAM_SIZE
	hex "memory size for Minos"
	default 0x4000000
	range 0x1000000 0x4000000
	help
	  the memory size for Minos

config NR_CPUS
	int "number of cpu in system"
	default 2
	help
	  how many cpu in current system

config UART_BASE
	hex "uart controller iomem base address"
	default 0xd0012000

config UART_IO_SIZE
	hex "uart controller iomem size"
	default 0x1000

endif
```

## platform/fvp/Kconfig
```kconfig
if SOC_FVP

config MINOS_START_ADDRESS
	hex "memory start address of system"
	default 0xc0000000

config MINOS_ENTRY_ADDRESS
	hex "entry address of system"
	default 0xc0008000
	help
	  the entry address is the start address plus
	  nr_cpus * TASK_STACK_SIZE

config MINOS_RAM_SIZE
	hex "memory size for Minos"
	default 0x40000000
	range 0x10000000 0x40000000
	help
	  the memory size for Minos

config NR_CPUS
	int "number of cpu in system"
	default 4
	help
	  how many cpu in current system

config UART_BASE
	hex "uart controller iomem base address"
	default 0x1c0a0000

config UART_IO_SIZE
	hex "uart controller iomem size"
	default 0x1000

endif
```

## platform/qemu/Kconfig
```kconfig
if SOC_QEMU

config MINOS_ENTRY_ADDRESS
	hex "entry address of system"
	default 0x40000000
	help
	  the entry address is the start address plus
	  nr_cpus * TASK_STACK_SIZE

config MINOS_RAM_SIZE
	hex "memory size for Minos"
	default 0x4000000
	range 0x1000000 0x4000000
	help
	  the memory size for Minos

config NR_CPUS
	int "number of cpu in system"
	default 4
	help
	  how many cpu in current system

config UART_BASE
	hex "uart controller iomem base address"
	default 0x90000000

config UART_IO_SIZE
	hex "uart controller iomem size"
	default 0x1000

config UART_IRQ
	int "the irq number for uart"
	default 33

endif
```

## platform/r8a7795/Kconfig
```kconfig
# SPDX-License-Identifier: GPL-2.0

if SOC_R8A7795

config MINOS_START_ADDRESS
	hex "memory start address of system"
	default 0x48000000

config MINOS_ENTRY_ADDRESS
	hex "entry address of system"
	default 0x48010000
	help
	  MINOS_START_ADDRESS + TASK_STACK_SIZE * NR_CPUS

config MINOS_RAM_SIZE
	hex "memory size for Minos"
	range 0x1000000 0x4000000
	default 0x2000000
	help
	  the memory size for Minos

config NR_CPUS
	int "number of cpu in system"
	range 1 1 if !SMP
	range 1 8
	default 1 if !SMP
	default 8
	help
	  how many cpu in current system

config UART_BASE
	hex "uart controller iomem base address"
	default 0xe6e88000

config UART_IO_SIZE
	hex "uart controller iomem size"
	default 0x1000

config MINOS_TEXT_OFFSET
	hex "entry offset from start of ram"
	default 0x10000
	help
	  MINOS_ENTRY_ADDRESS - 0x48000000

config DTB_LOAD_ADDRESS
	hex "device tree blob address"
	default 0x49e00000
	help
	  MINOS_START_ADDRESS + MINOS_RAM_SIZE - 0x200000

config HVM_SPI_VIRQ_NR
	int "SPI VIRQ for vm0"
	default 480
	help
	  NR_SPI_IRQS

config GVM_SPI_VIRQ_NR
	int "SPI VIRQ for non-vm0"
	default 480
	help
	  NR_SPI_IRQS

endif
```

## platform/raspberry3/Kconfig
```kconfig
if SOC_BCM2837

config PLATFORM_BCM2837
	def_bool y
	select VIRQCHIP_BCM2836
	select IRQCHIP_BCM2836

config MINOS_ENTRY_ADDRESS
	hex "entry address of system"
	default 0x28008000
	help
	  the entry address is the start address plus
	  nr_cpus * TASK_STACK_SIZE

config MINOS_RAM_SIZE
	hex "memory size for Minos"
	default 0x2000000
	range 0x1000000 0x4000000
	help
	  the memory size for Minos

config NR_CPUS
	int "number of cpu in system"
	default 4
	help
	  how many cpu in current system

config UART_BASE
	hex "uart controller iomem base address"
	default 0x3f215040

config UART_IO_SIZE
	hex "uart controller iomem size"
	default 0x1000

config HVM_SPI_VIRQ_NR
	int "SPI VIRQ for vm0"
	default 96

endif
```

## virt/Kconfig
```kconfig
menu "Minos Virtualization Configuration"

config VIRT
	bool "virtualization support"
	select STACK_PAGE_ALIGN

if VIRT

config VIRTIO_MMIO
	def_bool y

config MAX_VM
	int "max virtual machine that system support"
	default 64

config VRTC_PL031
	bool "vrtc pl031 support"
	default y
	help
	  vrtc pl031 driver for Minos

config VWDT_SP805
	bool "vwdt sp805 support"
	default y
	help
	  vwdt sp805 support for Minos

source "virt/virq_chips/Kconfig"
source "virt/vmbox/Kconfig"
source "virt/os/Kconfig"

endif

endmenu
```

## virt/os/Kconfig
```kconfig
menu "VM operating system support"

config OS_LINUX_SUPPORT
	bool "Support linux based virtual machine"
	default y

config OS_XNU_SUPPORT
	bool "Support xnu based virtual machine"
	default y
	select VIRQCHIP_AIC

endmenu
```

## virt/virq_chips/Kconfig
```kconfig
menu "Virqchip controller support"

config VIRQCHIP_VGICV2
	bool "virqchip vgicv2 support"
	default y
	help
	  vgicv2 virtual interrupt controller drvier

config VIRQCHIP_VGICV3
	bool "virqchip vgicv3 support"
	default y
	help
	  vgicv3 virtual interrupt controller drvier

config VIRQCHIP_BCM2836
	bool "virqchip bcm2835 driver"
	default n
	help
	  boardcom bcm2835 virtual interrupt controller
	  driver

config VIRQCHIP_AIC
	bool "Support Apple Interrupt Controller"
	default n
	help
	  support virtual AIC

endmenu
```
